/*
 * Copyright 2011 Linaro Ltd.
 *
 * The code contained herein is licensed under the GNU General Public
 * License. You may obtain a copy of the GNU General Public License
 * Version 2 or later at the following locations:
 *
 * http://www.opensource.org/licenses/gpl-license.html
 * http://www.gnu.org/copyleft/gpl.html
 */

/ {
	display-timings {
		AUO800x600:AUOA104 {
			clock-frequency = <40000000>;
			hactive = <800>;
			vactive = <600>;
			hback-porch = <120>;
			hfront-porch = <100>;
			vback-porch = <10>;
			vfront-porch = <8>;
			hsync-len = <36>;
			vsync-len = <10>;
		};
		
		hsd1024x768: hsd100pxn1 {
			clock-frequency = <65000000>;
			hactive = <1024>;
			vactive = <768>;
			hback-porch = <220>;
			hfront-porch = <40>;
			vback-porch = <21>;
			vfront-porch = <7>;
			hsync-len = <60>;
			vsync-len = <10>;
		};
	};
};
